/*
 * SAMSUNG EXYNOS9810 MALI device tree sourceA
 *
 * Copyright (c) 2019 Samsung Electronics Co., Ltd.
 *		http://www.samsung.com
 *
 * This program is free software; you can redistribute it and/or modify
 * it under the terms of the GNU General Public License version 2 as
 * published by the Free Software Foundation.
 */

#include "dt-bindings/soc/samsung/exynos9830-devfreq.h"

/{
	/* mali */
	mali: mali@18500000 {
		compatible = "arm,mali";
		reg = <0x0 0x18500000 0x5000>;
		sysreg_g3d = <0x18420000>;
		interrupts = <GIC_SPI INTREQ__G3D_IRQJOB IRQ_TYPE_LEVEL_HIGH>,
				   <GIC_SPI INTREQ__G3D_IRQMMU IRQ_TYPE_LEVEL_HIGH>,
				   <GIC_SPI INTREQ__G3D_IRQGPU IRQ_TYPE_LEVEL_HIGH>;
		interrupt-names = "JOB", "MMU", "GPU";
		g3d_cmu_cal_id = <ACPM_DVFS_G3D>;
		power-domains = <&pd_embedded_g3d>;
		g3d_genpd_name = "pd-embedded_g3d";
		#cooling-cells = <2>; /* min followed by max */
		governor = "joint";
		interactive_info = <377000 94 0>;
		gpu_dvfs_table_size = <8 8>; /*<row col>*/
		/*  8 columns      freq  down   up  stay  mif   little  middle   big  */
		gpu_dvfs_table = <
			832000    78  100   5  2730000  2106000 2600000 3016000
			800000    78  100   5  2730000  2106000 2600000 3016000
			702000    78   90   5  2730000  2106000 2600000 3016000
			572000    78   90   1  2730000  2106000 2600000 3016000
			455000    75   85   1  2730000  1300000 1222000 1456000
			377000    78   90   1  1352000  1300000 1222000 1456000
			260000    78   93   1  1352000  1300000 1222000 1456000 >;
		gpu_sustainable_info = <832000 0x55 0x00 0x00 0x00>;
		gpu_pmqos_cpu_cluster_num = <3>;
		gpu_pmu_status_reg_offset = <0x2204>;
		gpu_pmu_status_local_pwr_mask = <0x1>; /*0x1 << 0*/
		gpu_max_clock = <832000>;
		gpu_min_clock = <260000>;
		gpu_dvfs_start_clock = <832000>;
		gpu_default_voltage = <800000>;
		gpu_voltage_offset_margin = <37500>;
		gpu_power_coeff = <625>;
		gpu_dvfs_time_interval = <5>; /*1 tick : 10ms*/
		gpu_dynamic_abb = <0>;
		gpu_early_clk_gating = <0x01>;
		gpu_dvs = <0x01>;
		gpu_inter_frame_pm = <1>;
		gpu_inter_frame_dynamic_util = <50>;
		gpu_inter_frame_dynamic_freq = <702000>;
		gpu_perf_gathering = <0>;
		gpu_runtime_pm_delay_time = <50>;
		gpu_dvfs_polling_time = <30>;
		gpu_pmqos_int_disable = <1>;
		gpu_pmqos_compute_mif_max_clock = <2535000>;
		gpu_pmqos_mif_max_clock = <2730000>;
		gpu_pmqos_mif_max_clock_base = <650000>;
		gpu_pmqos_g3d_clock = <832000 702000>;
		gpu_pmqos_cl2_max_clock = <1378000 1690000>;
		gpu_pmqos_cl1_max_clock = <1690000 0>;
		gpu_cl_dvfs_start_base = <156000>;
		gpu_debug_level = <3>; /*DEBUG(1) INFO(2) WARNING(3) ERROR(4)*/
		gpu_trace_level = <8>; /*TRACE_ALL*/
		gpu_mo_min_clock = <156000>;
		gpu_boost_gpu_min_lock = <0>;
		gpu_boost_egl_min_lock = <1872000>;
		gpu_vk_boost_max_lock = <832000>;
		gpu_vk_boost_mif_min_lock = <1014000>;
		gpu_bts_support = <1>;
		gpu_neg_boost_clock = <832000>;
		gpu_ess_id_type = <ESS_FLAG_G3D>;
	};
};
